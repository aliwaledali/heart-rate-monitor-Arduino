
#include <SPI.h>
#include <Wire.h>
#include <Adafruit_GFX.h>
#include <Adafruit_SSD1306.h>
#include <Fonts/FreeMonoBold18pt7b.h >
 
#define SCREEN_WIDTH 128 
#define SCREEN_HEIGHT 64 
#define OLED_RESET     4 
Adafruit_SSD1306 display(SCREEN_WIDTH, SCREEN_HEIGHT, &Wire, OLED_RESET);
 
#define NUMFLAKES     10 
#define bitmap1_height   128
#define bitmap1_width    32
const int Buzzer=9;
static const unsigned char PROGMEM bitmap1[] =
{ 0x0C, 0x03, 0x00, 0x00, 0x00, 0x00, 0x00, 0x00, 0x00, 0x00, 0x00, 0x00, 0x00, 0x00, 0x00, 0x00,
  0x3F, 0x9F, 0xC0, 0x00, 0x00, 0x00, 0x00, 0x00, 0x00, 0x00, 0x00, 0x00, 0x00, 0x00, 0x00, 0x00,
  0x7F, 0xFF, 0xE0, 0x00, 0x00, 0x00, 0x00, 0x00, 0x00, 0x00, 0x00, 0x00, 0x00, 0x00, 0x00, 0x00,
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  0x00, 0x00, 0x00, 0x00, 0x00, 0x00, 0x00, 0x00, 0x00, 0x00, 0x00, 0x00, 0x00, 0x00, 0x00, 0x00
};
 
static const unsigned char PROGMEM bitmap2[] =
{ 0x07, 0xF0, 0x0F, 0xF0, 0x00, 0x00, 0x00, 0x00, 0x00, 0x00, 0x00, 0x00, 0x00, 0x00, 0x00, 0x00,
  0x1F, 0xFE, 0x3F, 0xF8, 0x00, 0x00, 0x00, 0x00, 0x00, 0x00, 0x00, 0x00, 0x00, 0x00, 0x00, 0x00,
  0x3F, 0xFF, 0x7F, 0xFE, 0x00, 0x00, 0x00, 0x00, 0x00, 0x00, 0x00, 0x00, 0x00, 0x00, 0x00, 0x00,
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  0x00, 0x00, 0x00, 0x00, 0x00, 0x00, 0x00, 0x00, 0x00, 0x00, 0x00, 0x00, 0x00, 0x00, 0x00, 0x00
};
 
boolean countStatus;
int beat, bpm;
unsigned long millisBefore;
 
#define XPOS   0 // Indexes into the 'icons' array in function below
#define YPOS   1
#define DELTAY 2
 
// the setup routine runs once when you press reset:
void setup() {





  
  pinMode(Buzzer,OUTPUT);
  digitalWrite(Buzzer,LOW);
  // initialize serial communication at 9600 bits per second:
  Serial.begin(9600);
  // SSD1306_SWITCHCAPVCC = generate display voltage from 3.3V internally
  if (!display.begin(SSD1306_SWITCHCAPVCC, 0x3C)) { // Address 0x3D for 128x64
    Serial.println(F("SSD1306 allocation failed"));
    for (;;); // Don't proceed, loop forever
  }
  Serial.println("Starting...");
}
 
// the loop routine runs over and over again forever:
void loop() {
  // read the input on analog pin 0:
  int sensorValue = analogRead(A0);
  // print out the value you read:
  //Serial.println(sensorValue);
  if (countStatus == 0) {
    if (sensorValue > 600) {
      countStatus = 1;
      beat++;
      Serial.println("Beat Detected!");
      Serial.print("Beat : ");
      Serial.println(beat);
      showBitmap2();
      printText();
    }
  } else {
    if (sensorValue < 500) {
      showBitmap();
      printText();
      countStatus = 0;
    }
  }
  if (millis() - millisBefore > 15000) {
    bpm = beat * 4;
    beat = 0;
    Serial.print("BPM : ");
    
    Serial.println(bpm);
    printBPM();
    analogWrite(Buzzer,30);
    delay(2000);
   digitalWrite(Buzzer,LOW);
    millisBefore = millis();
  }
  delay(1);        // delay in between reads for stability
  //showBitmap();
}
void printText() {
  display.setFont(&FreeMonoBold18pt7b);
  display.setTextColor(WHITE);        // Draw white text
  display.setCursor(50, 30);            // Start at top-left corner
  display.print(beat);
  display.display();
}
 
void printBPM() {
  display.clearDisplay();
  display.setFont(&FreeMonoBold18pt7b);
  display.setTextColor(WHITE);        // Draw white text
  display.setCursor(0, 40);            // Start at top-left corner
  display.print("BPM:"+(String)bpm);
  display.display();
}
 
void showBitmap(void) {
  display.clearDisplay();
  display.drawBitmap(5, 12, bitmap1, bitmap1_height, bitmap1_width, WHITE);
  display.display();
  //delay(1000);
}
 
void showBitmap2(void) {
  display.clearDisplay();
  display.drawBitmap(0, 5, bitmap2, bitmap1_height, bitmap1_width, WHITE);
  display.display();
  //delay(1000);
}
